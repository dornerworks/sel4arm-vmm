## apps/communication-server/Kconfig
```kconfig
#
# Copyright 2017, Data61
# Commonwealth Scientific and Industrial Research Organisation (CSIRO)
# ABN 41 687 119 230.
#
# Copyright 2018, DornerWorks
#
# This software may be distributed and modified according to the terms of
# the BSD 2-Clause license. Note that NO WARRANTY is provided.
# See "LICENSE_BSD2.txt" for details.
#
# @TAG(DATA61_DORNERWORKS_BSD)
#

menuconfig APP_COMM_SERVER
    bool "Communication Server used for VM to VM communication"
    default n
    depends on LIB_SEL4 && (LIB_MUSL_C || LIB_SEL4_C) && LIB_SEL4_MUSLC_SYS && LIB_UTILS
    help
        Contains the communication server process.
```

## apps/linux/Kconfig
```kconfig
#
# Copyright 2014, NICTA
#
# This software may be distributed and modified according to the terms of
# the BSD 2-Clause license. Note that NO WARRANTY is provided.
# See "LICENSE_BSD2.txt" for details.
#
# @TAG(NICTA_BSD)
#

menu "Linux"
    config APP_LINUX
        bool "linux"
        default y
        help
            Linux for Zynqmp

    config APP_LINUX_IMAGE_PREFIX
        string "Linux Image Prefix"
        depends on APP_LINUX
        default "Image" if PLAT_ZYNQMP
        default "fsl-image-vm" if PLAT_IMX8
        help
            Prefix on the names of the Linux images in
            apps/linux/(platform). This part of the file name
            will be replaced with linux-
endmenu
```
